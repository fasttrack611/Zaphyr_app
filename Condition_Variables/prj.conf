## prj.conf
```kconfig
CONFIG_STDOUT_CONSOLE=y
# enable to use thread names
CONFIG_THREAD_NAME=y
CONFIG_UART_CONSOLE=y
CONFIG_SERIAL=y

CONFIG_SERIAL=y
CONFIG_UART_CONSOLE=y
CONFIG_UART_INTERRUPT_DRIVEN=y

CONFIG_PRINTK=y
CONFIG_MAIN_STACK_SIZE=1024
#CONFIG_TIMER=y
CONFIG_SYS_CLOCK_EXISTS=y
#CONFIG_WORKQUEUE=y

CONFIG_SCHED_CPU_MASK=y
```

## src/main.c
```c
#include <zephyr/kernel.h>
#include <zephyr/sys/printk.h>

// Thread stack size and priorities
#define STACK_SIZE 1024
#define THREAD_A_PRIO 5
#define THREAD_B_PRIO 5

// Declare synchronization primitives
K_MUTEX_DEFINE(mutex);              // Mutex to protect access to shared flag
K_CONDVAR_DEFINE(condvar);          // Condition variable for signaling between threads

volatile bool flag_ready = false;   // Shared flag indicating readiness

// Thread A: Waits for the condition to be met
void thread_a_fn(void)
{
    // Lock the mutex before checking the condition
    k_mutex_lock(&mutex, K_FOREVER);

    // Wait until flag_ready becomes true
    while (!flag_ready) {
        printk("Thread A: waiting for condition...\n");

        // Wait on the condition variable
        // This releases the mutex and puts the thread to sleep
        // When signaled, it re-acquires the mutex before continuing
        k_condvar_wait(&condvar, &mutex, K_FOREVER);
    }

    printk("Thread A: condition met, continuing work!\n");

    // Unlock the mutex after the condition is satisfied
    k_mutex_unlock(&mutex);
}

// Thread B: Sets the condition and signals Thread A
void thread_b_fn(void)
{
    // Simulate some delay before setting the condition
    k_sleep(K_SECONDS(2));

    // Lock the mutex before modifying the shared flag
    k_mutex_lock(&mutex, K_FOREVER);

    // Set the condition
    flag_ready = true;
    printk("Thread B: condition set, signaling thread A\n");

    // Signal the condition variable to wake up one waiting thread
    k_condvar_signal(&condvar);

    // Unlock the mutex
    k_mutex_unlock(&mutex);
}

// Define thread stacks and thread control blocks
K_THREAD_STACK_DEFINE(stack_a, STACK_SIZE);
K_THREAD_STACK_DEFINE(stack_b, STACK_SIZE);
struct k_thread thread_a_data;
struct k_thread thread_b_data;

// Main function: entry point
int main(void)
{
    printk("Condition variable demo started\n");

    // Create Thread A (waiter)
    k_thread_create(&thread_a_data, stack_a, STACK_SIZE,
                    (k_thread_entry_t)thread_a_fn,
                    NULL, NULL, NULL,
                    THREAD_A_PRIO, 0, K_NO_WAIT);

    // Create Thread B (signaler)
    k_thread_create(&thread_b_data, stack_b, STACK_SIZE,
                    (k_thread_entry_t)thread_b_fn,
                    NULL, NULL, NULL,
                    THREAD_B_PRIO, 0, K_NO_WAIT);

    return 0;
}


/* 
Concept Overview
Mutex (k_mutex): Ensures exclusive access to shared data (flag_ready).
Condition Variable (k_condvar): Allows one thread to wait for a condition to become true, and another thread to signal it.
Thread A: Waits until flag_ready == true.
Thread B: Sets flag_ready = true and signals Thread A to wake up.



    How It Works
Thread A starts and locks the mutex.
It checks flag_ready. Since it's false, it waits on the condition variable.
Thread B starts after a delay, locks the mutex, sets flag_ready = true, and signals the condition variable.
Thread A wakes up, re-acquires the mutex, sees that flag_ready is now true, and continues execution. */ 
```

## src/main_wkng_tiner.c
```c
#include <zephyr/kernel.h>
#include <zephyr/sys/printk.h>
#include <zephyr/kernel.h>

#define STACK_SIZE 1024
#define PRIORITY 5

// Declare delayable work items
struct k_work_delayable work1;
struct k_work_delayable work2;

// Shared work handler
void deferred_work_handler(struct k_work *work) {
    if (work == &work1.work) {
        printk(" Deferred work from Timer 1\n");
    } else if (work == &work2.work) {
        printk(" Deferred work from Timer 2\n");
    } else {
        printk(" Unknown work source\n");
    }
}

// ISR-like timer expiry functions
void timer1_expiry(struct k_timer *timer) {
    printk(" Timer 1 interrupt fired\n");
    k_work_schedule(&work1, K_MSEC(500));  // Delay before thread-level processing
}

void timer2_expiry(struct k_timer *timer) {
    printk(" Timer 2 interrupt fired\n");
    k_work_schedule(&work2, K_MSEC(1000)); // Slightly longer delay
}

// Define two independent timers with static handlers
K_TIMER_DEFINE(timer1, timer1_expiry, NULL);
K_TIMER_DEFINE(timer2, timer2_expiry, NULL);

int main(void) {
    printk(" Zephyr multi-interrupt + delayed work demo started\n");

    // Initialize delayable work items with shared handler
    k_work_init_delayable(&work1, deferred_work_handler);
    k_work_init_delayable(&work2, deferred_work_handler);

    // Start timers: first fires in 1s, then every 3s/4s respectively
    k_timer_start(&timer1, K_SECONDS(1), K_SECONDS(3));
    k_timer_start(&timer2, K_SECONDS(2), K_SECONDS(4));

    while (1) {
        // Main thread stays idle while timers and work system operate
        k_sleep(K_SECONDS(10));
    }

    return 0;
}
```
