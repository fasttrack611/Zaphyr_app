## CMakeLists.txt
```
# SPDX-License-Identifier: Apache-2.0

cmake_minimum_required(VERSION 3.20.0)

find_package(Zephyr REQUIRED HINTS $ENV{ZEPHYR_BASE})
project(Thread_Scheduling)

target_sources(app PRIVATE src/main.c)
```

## prj.conf
```kconfig
CONFIG_STDOUT_CONSOLE=y
# enable to use thread names
CONFIG_THREAD_NAME=y
CONFIG_SCHED_CPU_MASK=y
CONFIG_PRINTK=y
CONFIG_MAIN_STACK_SIZE=1024

CONFIG_HEAP_MEM_POOL_SIZE=4096 
CONFIG_SMP=y
CONFIG_MP_MAX_NUM_CPUS=2
CONFIG_MULTITHREADING=y

#CONFIG_PREEMPT_ENABLED=y
```

## src/main.c
```c
#include <zephyr/kernel.h>
#include <zephyr/sys/printk.h>

#include <zephyr/kernel.h>
#include <zephyr/sys/printk.h>

#define STACK_SIZE 1024
#define THREAD_PRIO 5

// Define FIFO statically
K_FIFO_DEFINE(my_fifo);

// Define data item structure
struct data_item_t {
    void *fifo_reserved;  // Required for FIFO linkage
    int value;
};

// Producer thread: generates data
void producer_fn(void *p1, void *p2, void *p3)
{
    int count = 0;
    while (1) {
        struct data_item_t *item = k_malloc(sizeof(struct data_item_t));
        item->value = count++;

        printk("Producer: sending %d\n", item->value);
        k_fifo_put(&my_fifo, item);

        k_sleep(K_MSEC(500));
    }
}

// Consumer thread: processes data
void consumer_fn(void *p1, void *p2, void *p3)
{
    while (1) {
        struct data_item_t *item = k_fifo_get(&my_fifo, K_FOREVER);
        printk("Consumer: received %d\n", item->value);
        k_free(item);
    }
}

// Thread declarations
K_THREAD_STACK_DEFINE(producer_stack, STACK_SIZE);
K_THREAD_STACK_DEFINE(consumer_stack, STACK_SIZE);
struct k_thread producer_data;
struct k_thread consumer_data;

int main(void)
{
    printk("FIFO demo started\n");

    k_thread_create(&producer_data, producer_stack, STACK_SIZE,
                    producer_fn, NULL, NULL, NULL,
                    THREAD_PRIO, 0, K_NO_WAIT);

    k_thread_create(&consumer_data, consumer_stack, STACK_SIZE,
                    consumer_fn, NULL, NULL, NULL,
                    THREAD_PRIO, 0, K_NO_WAIT);

    return 0;
}
```
